## app/sysbuild/mcuboot/boards/xiao_nrf54l15_nrf54l15_cpuapp.conf
```kconfig
# Ported from Blinky MCUboot config — settings not already in the common prj.conf
CONFIG_FPROTECT=y
CONFIG_PRINTK=y
CONFIG_SERIAL=n
CONFIG_UART_CONSOLE=n
CONFIG_USE_SEGGER_RTT=y
CONFIG_RTT_CONSOLE=y
CONFIG_CONSOLE=y
CONFIG_LOG=y
CONFIG_LOG_MODE_IMMEDIATE=y
CONFIG_GPIO=n
CONFIG_CONSOLE_HANDLER=n
CONFIG_BOOT_BANNER=n
CONFIG_NCS_BOOT_BANNER=n
CONFIG_TIMESLICING=n
CONFIG_RESET_ON_FATAL_ERROR=n
CONFIG_MULTITHREADING=n
CONFIG_TIMEOUT_64BIT=n
CONFIG_NRF_ENABLE_ICACHE=n
CONFIG_SIZE_OPTIMIZATIONS=y
CONFIG_LTO=y
CONFIG_ISR_TABLES_LOCAL_DECLARATION=y

# nRF54L15 board-specific MCUboot overrides from Blinky
CONFIG_HW_STACK_PROTECTION=n
CONFIG_BOOT_WATCHDOG_FEED=n
CONFIG_TICKLESS_KERNEL=y
CONFIG_PM_EXTERNAL_FLASH_MCUBOOT_SECONDARY=n
```

## snippets/xiao-nrf54l15/boards/xiao_nrf54l15_nrf54l15_cpuapp.conf
```kconfig
# MCUboot image management for app-side firmware updates
CONFIG_FLASH=y
CONFIG_FLASH_MAP=y
CONFIG_STREAM_FLASH=y

CONFIG_IMG_MANAGER=y
CONFIG_MCUBOOT_IMG_MANAGER=y

# bluetooth subsystem and role
CONFIG_BT=y
CONFIG_BT_PERIPHERAL=y
CONFIG_BT_DEVICE_NAME="SnailScale"

# mcumgr smp over ble ota dfu
CONFIG_NCS_SAMPLE_MCUMGR_BT_OTA_DFU=y
CONFIG_NCS_SAMPLE_MCUMGR_BT_OTA_DFU_SPEEDUP=y
CONFIG_MCUMGR_TRANSPORT_BT_PERM_RW_AUTHEN=y
CONFIG_MCUBOOT_IMGTOOL_SIGN_VERSION="1.0.0+0"

# stack sizes for background flash operations
CONFIG_SYSTEM_WORKQUEUE_STACK_SIZE=4096
CONFIG_MAIN_STACK_SIZE=4096
```

## west.yml
```yaml
manifest:
  remotes:
    - name: ncs
      url-base: https://github.com/nrfconnect
    - name: elvishuynh
      url-base: https://github.com/elvishuynh

  projects:
    - name: nrf
      repo-path: sdk-nrf
      remote: ncs
      revision: v3.3.1
      import: true

    - name: zephyr-tm1640-driver
      remote: elvishuynh
      revision: main

    - name: pt18-led-matrix-module
      remote: elvishuynh
      revision: main

  self:
    path: SnailScale
```
