#include "../../../dts/partitions.dtsi"
/ {
	chosen {
		zephyr,code-partition = &boot_partition;
	};
};

/* Restore full RRAM and SRAM for MCUboot, same FLRP flatten as the app overlay */
&cpuapp_rram {
	reg = <0x0 DT_SIZE_K(1524)>;
};

&cpuapp_sram {
	reg = <0x20000000 DT_SIZE_K(256)>;
	ranges = <0x0 0x20000000  0x40000>;
};
